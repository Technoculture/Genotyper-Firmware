## scratch/docs/sample_projects/zephyr/boards/arm/som_nrf52811/Kconfig.defconfig
```kconfig
if BOARD_SOM_NRF52811

config BOARD
	default "som_nrf52811"

config BT_CTLR
	default BT

endif # BOARD_SOM_NRF52811
```

## scratch/docs/sample_projects/zephyr/boards/arm/som_nrf52811/som_nrf52811_defconfig
```kconfig
CONFIG_SOC_SERIES_NRF52X=y
CONFIG_SOC_NRF52811_QFAA=y
CONFIG_BOARD_SOM_NRF52811=y

# Enable MPU
CONFIG_ARM_MPU=y

# Enable hardware stack protection
CONFIG_HW_STACK_PROTECTION=y

# Enable UART
CONFIG_SERIAL=y

# enable console
CONFIG_CONSOLE=y
CONFIG_UART_CONSOLE=y

# enable GPIO
CONFIG_GPIO=y
CONFIG_I2C=y

# additional board options
CONFIG_GPIO_AS_PINRESET=y

# Bluetooth not enabled by default on nRF52811 due to RAM limitations when
# running the default set of kernel tests.
# Enable this on your prj.conf to include Bluetooth support
```

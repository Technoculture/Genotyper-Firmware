## CMakeLists.txt
```
cmake_minimum_required(VERSION 3.13.1)
find_package(Zephyr REQUIRED HINTS $ENV{ZEPHYR_BASE})

project(print_k)

target_sources(app PRIVATE src/main.c)
```

## prj.conf
```kconfig
# NOTHING HERE CURRENTLY
```

## src/main.c
```c
#include <zephyr.h>

int main()
{
    printk("HelloWorld");
    return 0;
}
```
